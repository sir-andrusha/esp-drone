## sdkconfig.defaults
```kconfig
CONFIG_ESP32_PHY_MAX_WIFI_TX_POWER=20
CONFIG_ESP32_PHY_MAX_TX_POWER=20

# CONFIG_FREERTOS_UNICORE=n
CONFIG_FREERTOS_NO_AFFINITY=0x7FFFFFFF
CONFIG_FREERTOS_CORETIMER_0=y
CONFIG_FREERTOS_OPTIMIZED_SCHEDULER=y
CONFIG_FREERTOS_HZ=1000
CONFIG_FREERTOS_SUPPORT_STATIC_ALLOCATION=y
CONFIG_FREERTOS_USE_STATS_FORMATTING_FUNCTIONS=y
CONFIG_FREERTOS_IDLE_TASK_STACKSIZE=2048
CONFIG_FREERTOS_ISR_STACKSIZE=2048
CONFIG_FREERTOS_ENABLE_BACKWARD_COMPATIBILITY=y

CONFIG_COMPILER_OPTIMIZATION_PERF=y
CONFIG_COMPILER_OPTIMIZATION_ASSERTIONS_ENABLE=y
CONFIG_COMPILER_STACK_CHECK_MODE_NONE=y

CONFIG_FREERTOS_TIMER_TASK_STACK_DEPTH=4096
CONFIG_ESPTOOLPY_FLASHMODE_QIO=y
CONFIG_ESPTOOLPY_FLASHFREQ_80M=y

CONFIG_FREERTOS_VTASKLIST_INCLUDE_COREID=y
CONFIG_FREERTOS_USE_TRACE_FACILITY=y
CONFIG_FREERTOS_GENERATE_RUN_TIME_STATS=y


# Override some defaults in mesh application project.

#
# Serial flasher config
#
CONFIG_ESPTOOLPY_FLASHSIZE_4MB=y

#
# Partition Table
#
CONFIG_PARTITION_TABLE_CUSTOM=y
# CONFIG_PARTITION_TABLE_SINGLE_APP=y

#
# FreeRTOS
#
CONFIG_FREERTOS_UNICORE=y
# CONFIG_FREERTOS_HZ=1000
# CONFIG_FREERTOS_TIMER_TASK_STACK_DEPTH=3072
# CONFIG_FREERTOS_USE_TRACE_FACILITY=y
CONFIG_FREERTOS_USE_STATS_FORMATTING_FUNCTIONS=y
# CONFIG_FREERTOS_VTASKLIST_INCLUDE_COREID=y
# CONFIG_FREERTOS_GENERATE_RUN_TIME_STATS=y

#
# ESP32-specific
#
CONFIG_ESP_TASK_WDT_PANIC=y
CONFIG_ESP_TASK_WDT_TIMEOUT_S=10
CONFIG_ESP32_ENABLE_COREDUMP=y
CONFIG_ESP_TIMER_TASK_STACK_SIZE=4096

#
# Wi-Fi
#
CONFIG_ESP32_WIFI_AMPDU_TX_ENABLED=
CONFIG_ESP32_WIFI_AMPDU_RX_ENABLED=

# LWIP
CONFIG_LWIP_IP_FORWARD=y
CONFIG_LWIP_IPV4_NAPT=y

CONFIG_MESH_LITE_ENABLE=y

CONFIG_BRIDGE_SOFTAP_SSID_END_WITH_THE_MAC=y


# App settigs

CONFIG_BRIDGE_SOFTAP_SSID="grouter"
CONFIG_BRIDGE_SOFTAP_PASSWORD="12345678"

# this is address of PC where esp-drone-graouncontrol in run
CONFIG_SERVER_IP="192.168.5.2"
CONFIG_SERVER_PORT=8070
```
